## config/Kconfig.shield
```kconfig
# Copyright (c) 2020 Pete Johanson
# SPDX-License-Identifier: MIT

config SHIELD_ALMOND_CAKE_LEFT
    def_bool $(shields_list_contains,almond_cake_left)

config SHIELD_ALMOND_CAKE_RIGHT
    def_bool $(shields_list_contains,almond_cake_right)
```
